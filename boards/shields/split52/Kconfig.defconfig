## boards/shields/split52/Kconfig.defconfig
```kconfig
if SHIELD_SPLIT52_LEFT

config ZMK_KEYBOARD_NAME
  default "split52"

config ZMK_SPLIT_ROLE_CENTRAL
  default y

endif

if SHIELD_SPLIT52_LEFT || SHIELD_SPLIT52_RIGHT

config ZMK_SPLIT
  default y

endif
```

## boards/shields/split52/Kconfig.shield
```kconfig
config SHIELD_SPLIT52_LEFT
  def_bool $(shields_list_contains,split52_left)

config SHIELD_SPLIT52_RIGHT
  def_bool $(shields_list_contains,split52_right)
```
